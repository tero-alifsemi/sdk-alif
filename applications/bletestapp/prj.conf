## prj.conf
```kconfig
# Copyright (C) Alif Semiconductor - All Rights Reserved.
# Use, distribution and modification of this code is permitted under the
# terms stated in the Alif Semiconductor Software License Agreement
#
# You should have received a copy of the Alif Semiconductor Software
# License Agreement with this file. If not, please write to:
# contact@alifsemi.com, or visit: https://alifsemi.com/license

CONFIG_BT=y

# For Alif Semiconductor Bluetooth Custom Configuration
#CONFIG_BT_CUSTOM=y

# For Zephyr Bluetooth Configuration
CONFIG_BT_PERIPHERAL=y
CONFIG_BT_DEVICE_NAME_DYNAMIC=y

CONFIG_ASSERT=y
CONFIG_IDLE_STACK_SIZE=2048
CONFIG_COUNTER=y

CONFIG_COUNTER_RTC_SNPS_DW=y
CONFIG_ALIF_POWER_MGR_SHELL=y

CONFIG_PM=y
CONFIG_PM_DEVICE=y
CONFIG_POWER_DOMAIN=y
CONFIG_PM_S2RAM=y
CONFIG_PM_SAU_SAVE_RESTORE=y

CONFIG_SYS_CLOCK_TICKS_PER_SEC=1000
CONFIG_STDOUT_CONSOLE=y
CONFIG_PRINTK=y
CONFIG_POWEROFF=y
CONFIG_BOOT_BANNER=n

CONFIG_SHELL=y
CONFIG_SHELL_AUTOSTART=n
CONFIG_ALIF_TESTCOMMANDS_SHELL=y

CONFIG_LOG=y
CONFIG_LOG_PRINTK=n



#############
CONFIG_LOG_BACKEND_UART=y
#############



# application logging level
CONFIG_MAIN_LOG_LEVEL_INF=y

CONFIG_ALIF_PM_SLEEP_ENABLE=1

####### Configuration supported with the upddated Secure Enclave software

# CONFIG_SYS_CLOCK_HW_CYCLES_PER_SEC=76800000

CONFIG_ALIF_EXT_WAKEUP_TIME=0
CONFIG_ALIF_OSC_WAKEUP_TIME=1700
CONFIG_ALIF_RM_WAKEUP_TIME=0
CONFIG_ALIF_EXT_WARMBOOT_WAKEUP_TIME=3000
CONFIG_SE_SERVICE_INIT_PRIORITY=1
CONFIG_KERNEL_INIT_PRIORITY_DEFAULT=0
CONFIG_GPIO_INIT_PRIORITY=40

CONFIG_ALIF_MAX_SLEEP_CLOCK_DRIFT=252
CONFIG_ALIF_MAX_ACTIVE_CLOCK_DRIFT=252

CONFIG_DATA_STRING_LENGTH=243
CONFIG_CORTEX_M_SYSTICK_LPM_TIMER_HOOKS=y

# Increase shell max commands so that we can set run_cfg and off_cfg
CONFIG_SHELL_ARGC_MAX=32
CONFIG_SHELL_CMD_BUFF_SIZE=384

# Should not need this but fixes missing prints with 76.8 RC clock.. Bug somewhere?
CONFIG_LOG_MODE_IMMEDIATE=y
```

## src/main.c
```c
/* Copyright (C) Alif Semiconductor - All Rights Reserved.
 * Use, distribution and modification of this code is permitted under the
 * terms stated in the Alif Semiconductor Software License Agreement
 *
 * You should have received a copy of the Alif Semiconductor Software
 * License Agreement with this file. If not, please write to:
 * contact@alifsemi.com, or visit: https://alifsemi.com/license
 */

#include <zephyr/kernel.h>
#include <zephyr/logging/log.h>

#include <zephyr/device.h>
#include <zephyr/drivers/gpio.h>
#include <zephyr/init.h>
#include <zephyr/pm/pm.h>
#include <zephyr/pm/policy.h>
#include <zephyr/sys/poweroff.h>
#include <zephyr/drivers/counter.h>
#include <zephyr/drivers/uart.h>
#include <cmsis_core.h>
#include <soc_common.h>
#include <se_service.h>
#include <es0_power_manager.h>

#include "appl_shell.h"
#include "power_mgr.h"
#include "ble_handler.h"

#include <zephyr/drivers/pinctrl.h>
#include <zephyr/dt-bindings/pinctrl/balletto-pinctrl.h>

#if !defined(CONFIG_SOC_SERIES_B1)
#error "Application works only with B1 devices"
#endif

static volatile int run_profile_error;

/* Macros */
LOG_MODULE_REGISTER(main, CONFIG_MAIN_LOG_LEVEL);

/**
 * PM Notifier callback for power state entry
 */
static void pm_notify_state_entry(enum pm_state const state)
{
	/* TODO: enable when this is needed */
	/*
	 * const struct pm_state_info *next_state = pm_state_next_get(0);
	 * uint8_t substate_id = next_state ? next_state->substate_id : 0;
	 */

	switch (state) {
	case PM_STATE_SUSPEND_TO_RAM:
	case PM_STATE_SOFT_OFF:
		break;
	default:
		__ASSERT(false, "Entering unknown power state %d", state);
		LOG_ERR("Entering unknown power state %d", state);
		break;
	}
}

/**
 * PM Notifier callback called BEFORE devices are resumed
 *
 * This restores SE run configuration when resuming from S2RAM states.
 * Note: For SOFT_OFF, the system resets completely and app_set_run_params()
 * runs during normal PRE_KERNEL_1 initialization, so this callback is not needed.
 */
static void pm_notify_pre_device_resume(enum pm_state const state)
{
	switch (state) {
	case PM_STATE_SUSPEND_TO_RAM: {
		run_profile_error = app_set_run_params();
		break;
	}
	case PM_STATE_SOFT_OFF: {
		/* No action needed - SOFT_OFF causes reset, not resume */
		break;
	}
	default: {
		__ASSERT(false, "Pre-resume for unknown power state %d", state);
		LOG_ERR("Pre-resume for unknown power state %d", state);
		break;
	}
	}
}

/**
 * PM Notifier structure
 */
static struct pm_notifier app_pm_notifier = {
	.state_entry = pm_notify_state_entry,
	.pre_device_resume = pm_notify_pre_device_resume,
};

/*
 * This function will be invoked in the PRE_KERNEL_1 phase of the init
 * routine to prevent sleep during startup.
 */
static int app_pre_kernel_init(void)
{
	/* Register PM notifier callbacks */
	pm_notifier_register(&app_pm_notifier);

	app_prevent_off();

	return 0;
}
SYS_INIT(app_pre_kernel_init, PRE_KERNEL_1, 39);

#if defined(CONFIG_CORTEX_M_SYSTICK_LPM_TIMER_HOOKS)

static uint32_t idle_timer_pre_idle;

/* Idle timer used for timer while entering the idle state */
static const struct device *idle_timer = DEVICE_DT_GET(DT_CHOSEN(zephyr_cortex_m_idle_timer));
/**
 * To simplify the driver, implement the callout to Counter API
 * as hooks that would be provided by platform drivers if
 * CONFIG_CORTEX_M_SYSTICK_LPM_TIMER_HOOKS was selected instead.
 */
void z_cms_lptim_hook_on_lpm_entry(uint64_t max_lpm_time_us)
{

	/* Store current value of the selected timer to calculate a
	 * difference in measurements after exiting the idle state.
	 */
	counter_get_value(idle_timer, &idle_timer_pre_idle);
	/**
	 * Disable the counter alarm in case it was already running.
	 */
	/* counter_cancel_channel_alarm(idle_timer, 0); */

	/* Set the alarm using timer that runs the idle.
	 * Needed rump-up/setting time, lower accurency etc. should be
	 * included in the exit-latency in the power state definition.
	 */

	struct counter_alarm_cfg cfg = {
		.callback = NULL,
		.ticks = counter_us_to_ticks(idle_timer, max_lpm_time_us) + idle_timer_pre_idle,
		.user_data = NULL,
		.flags = COUNTER_ALARM_CFG_ABSOLUTE,
	};
	counter_set_channel_alarm(idle_timer, 0, &cfg);
}

uint64_t z_cms_lptim_hook_on_lpm_exit(void)
{
	/**
	 * Calculate how much time elapsed according to counter.
	 */
	uint32_t idle_timer_post, idle_timer_diff;

	counter_get_value(idle_timer, &idle_timer_post);

	/**
	 * Check for counter timer overflow
	 * (TODO: this doesn't work for downcounting timers!)
	 */
	if (idle_timer_pre_idle > idle_timer_post) {
		idle_timer_diff = (counter_get_top_value(idle_timer) - idle_timer_pre_idle) +
				  idle_timer_post + 1;
	} else {
		idle_timer_diff = idle_timer_post - idle_timer_pre_idle;
	}

	return (uint64_t)counter_ticks_to_us(idle_timer, idle_timer_diff);
}
#endif /* CONFIG_CORTEX_M_SYSTICK_LPM_TIMER_COUNTER */

/* Pimpelipom */
static void set_profiles(void)
{
    const struct device *uart_dev = DEVICE_DT_GET(DT_CHOSEN(zephyr_console));
    int ret;
    uint32_t baudrate;

	/* Set the default off profile and apply it */
	get_default_off_cfg(&current_offp);
	ret = set_off_profile(PM_STATE_MODE_STOP_1);
	if (ret) {
		printk("set_off_profile failed: %d\n", ret);
		return;
	}

	/* Set the default run profile */
	/* Profile get is already done in power_mgr_init */
	ret = app_set_run_params();
	if (ret) {
		printk("app_set_run_params failed: %d\n", ret);
		return;
	}

	/* reconf UART */
	ret = uart_line_ctrl_get(uart_dev, UART_LINE_CTRL_BAUD_RATE, &baudrate);
    if (!ret) {
            ret = uart_line_ctrl_set(uart_dev, UART_LINE_CTRL_BAUD_RATE, baudrate);
    } else {
		printk("Failed to get UART baud rate: %d\n", ret);
		return;
	}

}

#define BOOT_PARAM_ID_PLF_DIAG            0xD4
#define BOOT_PARAM_ID_BLE_DIAG            0xD5
#define BOOT_PARAM_LEN_PLF_DIAG           4
#define BOOT_PARAM_LEN_BLE_DIAG           4
/* Tag, status and length bytes written by write_tlv_int() */
#define BOOT_PARAM_TLV_HDR_LEN            3

const pinctrl_soc_pin_t pinctrl_ble_dbg[] = {
	PIN_P7_0__BLE_DBG24 | 0x10000, /*Receiver enabled*/
	PIN_P7_1__BLE_DBG25 | 0x10000, /*Receiver enabled*/
	PIN_P7_2__BLE_DBG26 | 0x10000,  /*Receiver enabled*/
	PIN_P7_3__BLE_DBG27 | 0x10000,  /*Receiver enabled*/
	PIN_P7_4__BLE_DBG28 | 0x10000,
	PIN_P7_5__BLE_DBG29 | 0x10000,
	PIN_P7_6__BLE_DBG30 | 0x10000,
	PIN_P7_7__BLE_DBG31 | 0x10000};
	// PIN_P7_7__GPIO| 0x10000

#define DEFAULT_TAG_STATUS (0x00 | 0x02 | 0x04)

static uint8_t *write_tlv_int(uint8_t *target, uint8_t tag, uint32_t value, uint8_t len)
{
	*target++ = tag;
	*target++ = DEFAULT_TAG_STATUS;
	*target++ = len;
	if (len == 1) {
		memcpy(target, (uint8_t *)&value, len);
	} else if (len == 2) {
		memcpy(target, (uint16_t *)&value, len);
	} else {
		memcpy(target, &value, len);
	}

	target += len;

	return target;
}

void set_ble_debug(void)
{
	pinctrl_configure_pins(pinctrl_ble_dbg, ARRAY_SIZE(pinctrl_ble_dbg),
				       PINCTRL_REG_NONE);
}

uint16_t add_extra_nvds_param_length(void)
{
	printk("add_extra_nvds_param_length\n");

#if 0
	return 0;
#else
	return (BOOT_PARAM_TLV_HDR_LEN + BOOT_PARAM_LEN_PLF_DIAG) +
	       (BOOT_PARAM_TLV_HDR_LEN + BOOT_PARAM_LEN_BLE_DIAG);
#endif
}

uint8_t *add_extra_nvds_params(uint8_t *target)
{
	printk("add_extra_nvds_params\n");
#if 0
	return target;
#else
	target = write_tlv_int(target, BOOT_PARAM_ID_PLF_DIAG, 0x90838383 /* plf_diag_configs, 0x90838383 -> HCI Uart out to P7_0 - P7_7 */,
			    BOOT_PARAM_LEN_PLF_DIAG);
	target = write_tlv_int(target, BOOT_PARAM_ID_BLE_DIAG, 0x83838383 /* ble_diag_configs, 0x83838383 */,
			    BOOT_PARAM_LEN_BLE_DIAG);

	return target;
#endif
}

int main(void)
{
	int ret = 0;

	printk("BLE testapp cold start\n");

	// set_profiles();

	set_ble_debug();
	appl_wait_to_continue();


	ret = ble_init();
	if (ret) {
		printk("ble_init: %d\n", ret);
		return ret;
	}

	ret = ble_start();

	if (ret) {
		printk("ble_start: %d\n", ret);
		return ret;
	}

	printk("Init complete!\n");

	while (1) {
		if (ble_is_connected()) {
			k_sleep(K_MSEC(ble_rtc_connected_wakeup));
		} else {
			k_sleep(K_MSEC(ble_rtc_wakeup));
		}
	}
	return 0;
}
```

## src/appl_shell.c
```c
/* Copyright (C) Alif Semiconductor - All Rights Reserved.
 * Use, distribution and modification of this code is permitted under the
 * terms stated in the Alif Semiconductor Software License Agreement
 *
 * You should have received a copy of the Alif Semiconductor Software
 * License Agreement with this file. If not, please write to:
 * contact@alifsemi.com, or visit: https://alifsemi.com/license
 */

#include <zephyr/kernel.h>
#include <zephyr/shell/shell.h>
#include <zephyr/shell/shell_uart.h>
#include <zephyr/logging/log.h>
#include <stdlib.h>
#include "power_mgr.h"
#include "ble_handler.h"

LOG_MODULE_DECLARE(main, CONFIG_MAIN_LOG_LEVEL);

static struct k_sem waiting_semaphore;
static bool __attribute__((noinit)) force_ble_restart;
static bool __attribute__((noinit)) skip_wait;
static uint32_t __attribute__((noinit)) wakeup_time;

uint32_t ble_rtc_wakeup __attribute__((noinit));
uint32_t ble_rtc_connected_wakeup __attribute__((noinit));
uint16_t reset_after_sleep __attribute__((noinit));
enum lp_counter_source counter_source = -1;

void appl_shell_reset(void)
{
	skip_wait = false;
	force_ble_restart = false;
	wakeup_time = 0;
	ble_adv_int_min = 1000;
	ble_adv_int_max = 1000;
	ble_conn_int_min = 800;
	ble_conn_int_max = 800;
	ble_rtc_wakeup = 20000;
	ble_rtc_connected_wakeup = 20000;
	strncpy(app_shell_device_name, "APPL_SHL", DEVICE_NAME_LEN - 1);
	app_shell_device_name[8] = 0;
	reset_after_sleep = 0;
}

void appl_shell_init(void)
{
	/* Mark a cold boot */
	appl_shell_reset();
	k_sem_init(&waiting_semaphore, 0, 1);
}

static int app_shell_init(void)
{
	/* If we are sleeping dont set the shell prompt off */
	const struct shell *shell = shell_backend_uart_get_ptr();

	if (!shell) {
		return 0;
	}
	shell_start(shell);
	appl_shell_init();

	return 0;
}

SYS_INIT(app_shell_init, APPLICATION, 1);

int64_t param_get_int(size_t argc, char **argv, char *p_param, int def_value)
{
	if (p_param && argc > 1) {
		for (int n = 0; n < (argc - 1); n++) {
			if (strcmp(argv[n], p_param) == 0) {
				return strtoll(argv[n + 1], NULL, 0);
			}
		}
	}
	return def_value;
}

char *param_get_char(size_t argc, char **argv, char *p_param, char *def_value)
{
	if (p_param && argc > 1) {
		for (int n = 0; n < (argc - 1); n++) {
			if (strcmp(argv[n], p_param) == 0) {
				return argv[n + 1];
			}
		}
	}
	return def_value;
}

void appl_wait_to_continue(void)
{
	const struct shell *shell = shell_backend_uart_get_ptr();

	shell_print(shell, "BLE testapp started!\n");

	if (!skip_wait) {
		k_sem_take(&waiting_semaphore, K_FOREVER);
		LOG_INF("continuing.");
	}
}

/**
 * Application command functions
 **/
static int cmd_adv_int(const struct shell *shell, size_t argc, char **argv)
{
	ble_adv_int_min = param_get_int(argc, argv, "--min", ble_adv_int_min);
	ble_adv_int_max = param_get_int(argc, argv, "--max", ble_adv_int_max);

	shell_fprintf(shell, SHELL_VT100_COLOR_DEFAULT,
			"set advertisement interval min: %d max %d\n",
			ble_adv_int_min, ble_adv_int_max);
	return 0;
}
static int cmd_conn_int(const struct shell *shell, size_t argc, char **argv)
{
	ble_conn_int_min = param_get_int(argc, argv, "--min", ble_conn_int_min);
	ble_conn_int_max = param_get_int(argc, argv, "--max", ble_conn_int_max);

	shell_fprintf(shell, SHELL_VT100_COLOR_DEFAULT, "set connection interval min: %d max %d\n",
		      ble_conn_int_min, ble_conn_int_max);
	return 0;
}

static int cmd_int(const struct shell *shell, size_t argc, char **argv)
{
	unsigned long wakeup_time = strtoul(argv[1], 0, 10);

	if (wakeup_time) {
		ble_rtc_wakeup = wakeup_time;
	}
	ble_rtc_connected_wakeup =
		param_get_int(argc, argv, "--connected", ble_rtc_connected_wakeup);

	shell_fprintf(shell, SHELL_VT100_COLOR_DEFAULT, "set RTC wakeup: %d when connected %d\n",
		      ble_rtc_wakeup, ble_rtc_connected_wakeup);
	return 0;
}

static int cmd_continue(const struct shell *shell, size_t argc, char **argv)
{
	reset_after_sleep = param_get_int(argc, argv, "--reset_after", reset_after_sleep);
	skip_wait = true;
	k_sem_give(&waiting_semaphore);
	shell_print(shell, "BLEtestapp continue");
	return 0;
}

void appl_shell_sleep_period_end(void)
{
	if (reset_after_sleep) {
		const struct shell *shell = shell_backend_uart_get_ptr();
		int ret;

		appl_shell_reset();
		ret = ble_uninit();
		shell_print(shell, "BLE application is restarted %d", ret);
	}
}

static int cmd_sleep(const struct shell *shell, size_t argc, char **argv)
{
	uint32_t sleeptime_s = strtoul(argv[1], 0, 10);

	shell_print(shell, "start sleep cycle %d s", sleeptime_s);

	app_sleep_start(sleeptime_s);
	return 0;
}

static int cmd_set_name(const struct shell *shell, size_t argc, char **argv)
{
	if (skip_wait) {
		shell_error(shell, "Name must be set on POR, before continue is called.");
		return -ENOEXEC;
	}
	/* app_shell_device_name has null-ending as per cold boot init */
	strncpy(app_shell_device_name, argv[1],	DEVICE_NAME_LEN - 1);
	shell_print(shell, "BLE name set to %s", app_shell_device_name);
	return 0;
}

static int cmd_select_timer(const struct shell *shell, size_t argc, char **argv)
{
	if (!strcmp(argv[1], "LPRTC")) {
		counter_source = LPRTC;
		shell_print(shell, "Selected LPRTC as wakeup source");
	} else if (!strcmp(argv[1], "LPTIMER")) {
		counter_source = LPTIMER;
		shell_print(shell, "Selected LPTIMER as wakeup source");
	} else {
		shell_error(shell, "Select timer source from LPRTC and LPTIMER");
		return -ENOEXEC;
	}
	return 0;
}


static int cmd_set_offprofile(const struct shell *shell, size_t argc, char **argv)
{
	int ret;

	if (!strcmp(argv[1], "STOP")) {
		ret = set_off_profile(PM_STATE_MODE_STOP_1);

		if (ret) {
			shell_error(shell, "Failed to set off profile: %d", ret);
			return -ENOEXEC;
		}
		shell_print(shell, "Off profile set to STOP");
	} else if (!strcmp(argv[1], "IDLE")) {
		set_off_profile_configuration(PM_STATE_MODE_IDLE_1);
		current_offp.power_domains |= PD_SESS_MASK;
		ret = set_current_off_profile();

		if (ret) {
			shell_error(shell, "Failed to set off profile: %d", ret);
			return -ENOEXEC;
		}
		shell_print(shell, "Off profile set to IDLE");
	} else if (!strcmp(argv[1], "STANDBY")) {
		ret = set_off_profile(PM_STATE_MODE_STANDBY_1);

		if (ret) {
			shell_error(shell, "Failed to set off profile: %d", ret);
			return -ENOEXEC;
		}
		shell_print(shell, "Off profile set to STANDBY");
	} else {
		shell_error(shell, "Select off profile from STOP, IDLE, STANDBY");
		return -ENOEXEC;
	}
	return 0;
}

SHELL_STATIC_SUBCMD_SET_CREATE(
	sub_cmds,
	SHELL_CMD_ARG(adv-interval, NULL,
		      "configure advertisement interval --min <slots> --max <slots>", cmd_adv_int,
		      1, 10),
	SHELL_CMD_ARG(conn-interval, NULL,
		      "configure connection interval --min <slots> --max <slots>", cmd_conn_int, 1,
		      10),
	SHELL_CMD_ARG(interval, NULL,
		      "configure M55 wakeup interval <time in ms> --connected <time in ms>",
		      cmd_int, 1, 10),
	SHELL_CMD_ARG(continue, NULL, "Start ble application --reset_after <0/1>",
		cmd_continue, 1, 10),
	SHELL_CMD_ARG(sleep, NULL, "allow sleep in <seconds>", cmd_sleep, 2, 10),
	SHELL_CMD_ARG(init, NULL, "BLE stack initialize", cmd_sleep, 2, 10),
	SHELL_CMD_ARG(set-name, NULL, "set name for BLE <name>", cmd_set_name, 2, 10),
	SHELL_CMD_ARG(set_offprofile, NULL, "Set off profile", cmd_set_offprofile, 2, 10),
	SHELL_CMD_ARG(select_timer, NULL, "Select timer source <LPRTC/LPTIMER>",
		cmd_select_timer, 2, 10),
	SHELL_SUBCMD_SET_END);

SHELL_CMD_REGISTER(ble_appl, &sub_cmds, "Ble configuration commands", NULL);
```

## src/ble_handler_zephyr.c
```c
/* Copyright (C) Alif Semiconductor - All Rights Reserved.
 * Use, distribution and modification of this code is permitted under the
 * terms stated in the Alif Semiconductor Software License Agreement
 *
 * You should have received a copy of the Alif Semiconductor Software
 * License Agreement with this file. If not, please write to:
 * contact@alifsemi.com, or visit: https://alifsemi.com/license
 */

#include "ble_handler.h"

#include <errno.h>
#include <string.h>
#include <zephyr/kernel.h>
#include <zephyr/logging/log.h>

#include <zephyr/bluetooth/bluetooth.h>
#include <zephyr/bluetooth/conn.h>
#include <zephyr/bluetooth/gatt.h>
#include <zephyr/bluetooth/uuid.h>

#include "appl_shell.h"
#include <zephyr/shell/shell.h>
#include <zephyr/shell/shell_uart.h>

LOG_MODULE_DECLARE(main, CONFIG_MAIN_LOG_LEVEL);

static uint8_t hello_arr[] = "HelloHello";
static uint8_t hello_arr_index __attribute__((noinit));

/* BLE configurations*/
char __attribute__((noinit)) app_shell_device_name[DEVICE_NAME_LEN];

uint16_t ble_adv_int_min __attribute__((noinit));
uint16_t ble_adv_int_max __attribute__((noinit));
uint16_t ble_conn_int_min __attribute__((noinit));
uint16_t ble_conn_int_max __attribute__((noinit));

/* HELLO SERVICE and attribute 128 bit UUIDs */
#define HELLO_UUID_128_SVC_BYTES                                                                    \
	0x12, 0x34, 0x56, 0x78, 0x90, 0x12, 0x23, 0x34, 0x45, 0x56, 0x67, 0x78, 0x89, 0x90,       \
		0x00, 0x00
#define HELLO_UUID_128_CHAR0_BYTES                                                                  \
	0x12, 0x34, 0x56, 0x78, 0x90, 0x12, 0x23, 0x34, 0x45, 0x56, 0x67, 0x78, 0x89, 0x15,       \
		0x00, 0x00
#define HELLO_UUID_128_CHAR1_BYTES                                                                  \
	0x12, 0x34, 0x56, 0x78, 0x90, 0x12, 0x23, 0x34, 0x45, 0x56, 0x67, 0x78, 0x89, 0x16,       \
		0x00, 0x00

struct service_env {
	uint8_t char0_val[CONFIG_DATA_STRING_LENGTH];
	uint8_t char1_val;
	bool ntf_enabled;
};

static struct service_env env __attribute__((noinit));
static struct bt_conn *current_conn;
static bool conn_status __attribute__((noinit));
static bool ble_enabled;
static bool adv_restart_pending;

static struct bt_uuid_128 hello_svc_uuid = BT_UUID_INIT_128(HELLO_UUID_128_SVC_BYTES);
static struct bt_uuid_128 hello_char0_uuid = BT_UUID_INIT_128(HELLO_UUID_128_CHAR0_BYTES);
static struct bt_uuid_128 hello_char1_uuid = BT_UUID_INIT_128(HELLO_UUID_128_CHAR1_BYTES);

static ssize_t hello_read_char0(struct bt_conn *conn, const struct bt_gatt_attr *attr, void *buf,
				uint16_t len, uint16_t offset)
{
	ARG_UNUSED(conn);

	uint8_t loop_count = (CONFIG_DATA_STRING_LENGTH / 5U);

	if (CONFIG_DATA_STRING_LENGTH % 5U) {
		loop_count += 1U;
	}

	for (uint8_t i = 0U; i < loop_count; i++) {
		memcpy(env.char0_val + i * 5U, &hello_arr[hello_arr_index], 5U);
	}

	return bt_gatt_attr_read(conn, attr, buf, len, offset, env.char0_val,
				 CONFIG_DATA_STRING_LENGTH);
}

static ssize_t hello_write_char1(struct bt_conn *conn, const struct bt_gatt_attr *attr,
				 const void *buf, uint16_t len, uint16_t offset,
				 uint8_t flags)
{
	ARG_UNUSED(conn);
	ARG_UNUSED(attr);
	ARG_UNUSED(flags);

	if (offset != 0U) {
		return BT_GATT_ERR(BT_ATT_ERR_INVALID_OFFSET);
	}

	if (len != sizeof(env.char1_val)) {
		return BT_GATT_ERR(BT_ATT_ERR_INVALID_ATTRIBUTE_LEN);
	}

	memcpy(&env.char1_val, buf, sizeof(env.char1_val));
	LOG_DBG("TOGGLE LED, state %d", env.char1_val);

	return len;
}

static void hello_ccc_cfg_changed(const struct bt_gatt_attr *attr, uint16_t value)
{
	ARG_UNUSED(attr);
	env.ntf_enabled = (value == BT_GATT_CCC_NOTIFY);
}

BT_GATT_SERVICE_DEFINE(
	hello_svc, BT_GATT_PRIMARY_SERVICE(&hello_svc_uuid.uuid),
	BT_GATT_CHARACTERISTIC(&hello_char0_uuid.uuid, BT_GATT_CHRC_READ | BT_GATT_CHRC_NOTIFY,
			       BT_GATT_PERM_READ, hello_read_char0, NULL, NULL),
	BT_GATT_CCC(hello_ccc_cfg_changed, BT_GATT_PERM_READ | BT_GATT_PERM_WRITE),
	BT_GATT_CHARACTERISTIC(&hello_char1_uuid.uuid, BT_GATT_CHRC_WRITE, BT_GATT_PERM_WRITE,
			       NULL, hello_write_char1, &env.char1_val));

static int start_advertising(void);

static void adv_restart_work_handler(struct k_work *work)
{
	ARG_UNUSED(work);

	if (!ble_enabled || !adv_restart_pending || conn_status) {
		return;
	}

	int err = start_advertising();

	if (!err) {
		adv_restart_pending = false;
		return;
	}

	if (err == -ENOMEM) {
		LOG_WRN("Advertising restart deferred, waiting for conn recycle");
		return;
	}

	adv_restart_pending = false;
	LOG_ERR("restart advertising failed %d", err);
}

K_WORK_DEFINE(adv_restart_work, adv_restart_work_handler);

static int start_advertising(void)
{
	struct bt_le_adv_param adv_param = {
		.id = BT_ID_DEFAULT,
		.sid = 0,
		.secondary_max_skip = 0,
		.options = BT_LE_ADV_OPT_CONN | BT_LE_ADV_OPT_USE_IDENTITY,
		.interval_min = ble_adv_int_min,
		.interval_max = ble_adv_int_max,
		.peer = NULL,
	};
	struct bt_data ad[] = {
		BT_DATA_BYTES(BT_DATA_FLAGS, (BT_LE_AD_GENERAL | BT_LE_AD_NO_BREDR)),
		BT_DATA_BYTES(BT_DATA_UUID128_ALL, HELLO_UUID_128_SVC_BYTES),
		BT_DATA(BT_DATA_NAME_COMPLETE, app_shell_device_name,
			strlen(app_shell_device_name)),
	};

	int err = bt_set_name(app_shell_device_name);

	if (err) {
		LOG_WRN("bt_set_name failed %d, continuing with default device name", err);
	}

	(void)bt_le_adv_stop();

	err = bt_le_adv_start(&adv_param, ad, ARRAY_SIZE(ad), NULL, 0);
	if (err) {
		LOG_ERR("bt_le_adv_start error %d", err);
		return err;
	}

	LOG_INF("Advertising started name:%s int:[%u,%u]", app_shell_device_name,
		ble_adv_int_min, ble_adv_int_max);

	return 0;
}

static void connected(struct bt_conn *conn, uint8_t err)
{
	const struct shell *shell = shell_backend_uart_get_ptr();

	if (err) {
		shell_print(shell, "BLE connect failed (%u)", err);
		return;
	}

	if (current_conn != NULL) {
		bt_conn_unref(current_conn);
	}
	current_conn = bt_conn_ref(conn);
	conn_status = true;
	adv_restart_pending = false;

	struct bt_le_conn_param param = {
		.interval_min = ble_conn_int_min,
		.interval_max = ble_conn_int_max,
		.latency = 0,
		.timeout = 800,
	};

	err = bt_conn_le_param_update(conn, &param);
	if (err) {
		LOG_WRN("bt_conn_le_param_update failed %u", err);
	}

	shell_print(shell, "BLE Connected");
}

static void disconnected(struct bt_conn *conn, uint8_t reason)
{
	ARG_UNUSED(conn);
	const struct shell *shell = shell_backend_uart_get_ptr();

	conn_status = false;
	if (current_conn != NULL) {
		bt_conn_unref(current_conn);
		current_conn = NULL;
	}

	shell_print(shell, "BLE disconnected reason 0x%02x. Waiting new connection", reason);
	adv_restart_pending = true;
	k_work_submit(&adv_restart_work);
}

static void recycled(void)
{
	if (adv_restart_pending) {
		k_work_submit(&adv_restart_work);
	}
}

static struct bt_conn_cb conn_callbacks = {
	.connected = connected,
	.disconnected = disconnected,
	.recycled = recycled,
};

int ble_shell_reset(void)
{
	ble_adv_int_min = 1000;
	ble_adv_int_max = 1000;
	ble_conn_int_min = 800;
	ble_conn_int_max = 800;
	strncpy(app_shell_device_name, "test_shl", DEVICE_NAME_LEN - 1);
	app_shell_device_name[8] = 0;
	return 0;
}

SYS_INIT(ble_shell_reset, POST_KERNEL, 91);

int ble_init(void)
{
	if (ble_enabled) {
		return 0;
	}

	int err = bt_enable(NULL);

	if (err && err != -EALREADY) {
		LOG_ERR("bt_enable error %d", err);
		return err;
	}

	if (!ble_enabled) {
		bt_conn_cb_register(&conn_callbacks);
	}

	ble_enabled = true;

	if (app_shell_device_name[0] != '\0') {
		err = bt_set_name(app_shell_device_name);
		if (err) {
			LOG_WRN("bt_set_name failed %d", err);
		}
	}

	return 0;
}

int ble_start(void)
{
	if (!ble_enabled) {
		LOG_ERR("Bluetooth stack not initialized");
		return -EACCES;
	}

	hello_arr_index = 0;
	conn_status = false;
	adv_restart_pending = false;
	memset(&env, 0, sizeof(struct service_env));

	int err = start_advertising();
	if (err) {
		return err;
	}

	LOG_INF("start complete!");
	return 0;
}

int ble_uninit(void)
{
	conn_status = false;
	adv_restart_pending = false;
	(void)k_work_cancel(&adv_restart_work);
	(void)bt_le_adv_stop();

	if (current_conn != NULL) {
		(void)bt_conn_disconnect(current_conn, BT_HCI_ERR_REMOTE_USER_TERM_CONN);
		bt_conn_unref(current_conn);
		current_conn = NULL;
	}

	return 0;
}

bool ble_is_connected(void)
{
	return conn_status;
}

static int cmd_bt_disable(const struct shell *shell, size_t argc, char **argv)
{
	int ret;

	ble_shell_reset();
	ret = ble_uninit();
	shell_print(shell, "BLE application is restarted %d", ret);
	return 0;
}

static int cmd_bt_init(const struct shell *shell, size_t argc, char **argv)
{
	int ret = ble_init();

	shell_print(shell, "BLE stack init %d", ret);
	return 0;
}

static int cmd_bt_name(const struct shell *shell, size_t argc, char **argv)
{
	/* app_shell_device_name has null-ending as per cold boot init */
	strncpy(app_shell_device_name, argv[1], DEVICE_NAME_LEN - 1);
	shell_print(shell, "BLE name set to %s", app_shell_device_name);
	return 0;
}

static int cmd_bt_advertise(const struct shell *shell, size_t argc, char **argv)
{
	int ret;

	ret = ble_start();
	shell_print(shell, "BLE advertisement started %d", ret);
	return 0;
}

SHELL_STATIC_SUBCMD_SET_CREATE(
	sub_cmds,
	SHELL_CMD_ARG(init, NULL, "[none]", cmd_bt_init, 1, 10),
	SHELL_CMD_ARG(advertise, NULL, "<type: off, on, nconn>", cmd_bt_advertise, 1, 10),
	SHELL_CMD_ARG(disable, NULL, "[none]", cmd_bt_disable, 1, 10),
	SHELL_CMD_ARG(name, NULL, "[name]", cmd_bt_name, 2, 10),
	SHELL_SUBCMD_SET_END);
SHELL_CMD_REGISTER(bt, &sub_cmds, "bt - Bluetooth shell commands", NULL);
```

## src/power_mgr.c
```c
/* Copyright (C) Alif Semiconductor - All Rights Reserved.
 * Use, distribution and modification of this code is permitted under the
 * terms stated in the Alif Semiconductor Software License Agreement
 *
 * You should have received a copy of the Alif Semiconductor Software
 * License Agreement with this file. If not, please write to:
 * contact@alifsemi.com, or visit: https://alifsemi.com/license
 */

#include <zephyr/kernel.h>
#include <zephyr/logging/log.h>
#include <zephyr/pm/pm.h>
#include <zephyr/pm/policy.h>
#include <zephyr/drivers/counter.h>
#include <zephyr/shell/shell.h>
#include <zephyr/shell/shell_uart.h>
#include <cmsis_core.h>
#include <se_service.h>
#include "power_mgr.h"
#include "power_defines.h"
#include "ble_handler.h"
#include "appl_shell.h"

static void sleep_period_worker(struct k_work *work);
static K_WORK_DELAYABLE_DEFINE(sleep_dwork, sleep_period_worker);

LOG_MODULE_DECLARE(main, CONFIG_MAIN_LOG_LEVEL);

extern enum lp_counter_source counter_source;
static const struct device *wakeup_dev;
static bool counter_started;

run_profile_t current_runp __attribute__((noinit));
off_profile_t current_offp __attribute__((noinit));
int16_t power_profile __attribute__((noinit));

static int power_mgr_init(void)
{
	counter_started = false;
	wakeup_dev = 0;
	return select_timer_source(LPRTC);
}

int select_timer_source(enum lp_counter_source source)
{
	int ret = 0;

	if (counter_source == source) {
		return 0;
	}

	if (counter_started) {
		ret = counter_stop(wakeup_dev);
		if (ret && ret != -EALREADY) {
			printk("failed to stop counter: %d", ret);
			return -1;
		}
		counter_started = false;
	}

	wakeup_dev = 0;

	if (source == LPRTC) {
#ifndef WAKEUP_SOURCE_RTC
		printk("Wakeup Device RTC not enabled in the dts");
		return -1;
#else
		wakeup_dev = DEVICE_DT_GET(WAKEUP_SOURCE_RTC);
#endif
	} else if (source == LPTIMER) {
#ifndef WAKEUP_SOURCE_LPTIMER
		printk("Wakeup Device LPTIMER not enabled in the dts");
		return -1;
#else
		wakeup_dev = DEVICE_DT_GET(WAKEUP_SOURCE_LPTIMER);
#endif
	} else {
		LOG_ERR("Invalid timer source selected");
		return -1;
	}

	if (!device_is_ready(wakeup_dev)) {
		printk("%s: device not ready", wakeup_dev->name);
		return -1;
	}

	ret = counter_start(wakeup_dev);

	if (ret && ret != -EALREADY) {
		printk("failed to start counter: %d", ret);
		return -1;
	}

	counter_source = source;
	counter_started = true;
	get_default_off_cfg(&current_offp);
	ret = set_off_profile(PM_STATE_MODE_STOP_1);

	get_default_run_cfg(&current_runp);

	if (ret) {
		LOG_ERR("off profile set failed. error: %d", ret);
	}

	return 0;
}
SYS_INIT(power_mgr_init, POST_KERNEL, 99);

void app_ready_for_sleep(void)
{
	pm_policy_state_lock_put(PM_STATE_SOFT_OFF, PM_ALL_SUBSTATES);
	pm_policy_state_lock_put(PM_STATE_SUSPEND_TO_RAM, PM_ALL_SUBSTATES);
}

void app_prevent_off(void)
{
	pm_policy_state_lock_get(PM_STATE_SOFT_OFF, PM_ALL_SUBSTATES);
	pm_policy_state_lock_get(PM_STATE_SUSPEND_TO_RAM, PM_ALL_SUBSTATES);
}

static void sleep_period_worker(struct k_work *work)
{
	const struct shell *shell = shell_backend_uart_get_ptr();

	app_prevent_off();
	appl_shell_sleep_period_end();
	shell_print(shell, "sleep period done.");
}

void app_sleep_start(uint32_t time_s)
{
	k_work_reschedule(&sleep_dwork, K_MSEC((int64_t)time_s * MSEC_PER_SEC));
	app_ready_for_sleep();
}

int set_current_off_profile(void)
{
	int ret = se_service_set_off_cfg(&current_offp);

	if (ret) {
		LOG_ERR("SE: set_off_cfg failed = %d", ret);
	}
	return ret;
}

int set_off_profile_configuration(const enum pm_state_mode_type pm_mode)
{
	/* Set default for stop mode with RTC wakeup support */
	current_offp.power_domains = PD_VBAT_AON_MASK;
/* If CONFIG_FLASH_BASE_ADDRESS is zero application run from itcm and no MRAM needed */
#if (CONFIG_FLASH_BASE_ADDRESS == 0)
	current_offp.memory_blocks = 0;
#else
	current_offp.memory_blocks = MRAM_MASK;
#endif
	current_offp.memory_blocks |= SERAM_MEMORY_BLOCKS_IN_USE;
	current_offp.memory_blocks |= APP_RET_MEM_BLOCKS;
	current_offp.dcdc_voltage = 775;
	current_offp.vdd_ioflex_3V3 = IOFLEX_LEVEL_1V8;

	switch (pm_mode) {
	case PM_STATE_MODE_IDLE_1:
	case PM_STATE_MODE_STANDBY_1:
		current_offp.power_domains |= PD_SSE700_AON_MASK;
		current_offp.ip_clock_gating = 0;
		current_offp.phy_pwr_gating = 0;
		current_offp.dcdc_mode = DCDC_MODE_PFM_AUTO;
		break;
	case PM_STATE_MODE_STOP_1:
		current_offp.ip_clock_gating = 0;
		current_offp.phy_pwr_gating = 0;
		current_offp.dcdc_mode = DCDC_MODE_OFF;
		break;
	case PM_STATE_MODE_GO_1:
	case PM_STATE_MODE_GO_2:
	case PM_STATE_MODE_GO_3:
	case PM_STATE_MODE_GO_4:
	case PM_STATE_MODE_GO_5:
	case PM_STATE_MODE_READY_1:
	case PM_STATE_MODE_READY_2:
	case PM_STATE_MODE_IDLE_2:
	case PM_STATE_MODE_STOP_2:
	case PM_STATE_MODE_STOP_3:
	case PM_STATE_MODE_STOP_4:
	case PM_STATE_MODE_STOP_5:
		break;
	}

	current_offp.aon_clk_src = CLK_SRC_LFXO;
	current_offp.stby_clk_src = CLK_SRC_HFRC;
	current_offp.stby_clk_freq = SCALED_FREQ_RC_STDBY_0_075_MHZ;
	if (counter_source == LPRTC) {
		current_offp.ewic_cfg = EWIC_RTC_A;
		current_offp.wakeup_events = WE_LPRTC;
	} else if (counter_source == LPTIMER) {
		current_offp.ewic_cfg = EWIC_VBAT_TIMER;
		current_offp.wakeup_events = WE_LPTIMER;
	} else {
		LOG_ERR("Invalid timer source selected");
		return -1;
	}
	current_offp.vtor_address = SCB->VTOR;
	current_offp.vtor_address_ns = SCB->VTOR;

	return 0;
}

int set_off_profile(const enum pm_state_mode_type pm_mode)
{

	set_off_profile_configuration(pm_mode);
	return set_current_off_profile();
}

void get_default_run_cfg(run_profile_t *runp)
{
	runp->power_domains = PD_VBAT_AON_MASK | PD_SYST_MASK | PD_SSE700_AON_MASK;
	runp->power_domains |= PD_SESS_MASK | PD_DBSS_MASK;
	runp->dcdc_voltage = 775;
	runp->dcdc_mode = DCDC_MODE_PFM_FORCED;
	runp->aon_clk_src = CLK_SRC_LFXO;

// Whith this conf, logging is not working
//	runp->run_clk_src = CLK_SRC_HFRC;
//	runp->cpu_clk_freq = CLOCK_FREQUENCY_76_8_RC_MHZ;

	runp->run_clk_src = CLK_SRC_PLL;
	runp->cpu_clk_freq = CLOCK_FREQUENCY_160MHZ;

	runp->phy_pwr_gating = 0;
	runp->ip_clock_gating = 0;
	runp->vdd_ioflex_3V3 = IOFLEX_LEVEL_1V8;
	runp->scaled_clk_freq = SCALED_FREQ_RC_ACTIVE_76_8_MHZ;

	runp->memory_blocks = MRAM_MASK;
	runp->memory_blocks |= SERAM_MEMORY_BLOCKS_IN_USE;
	runp->memory_blocks |= APP_RET_MEM_BLOCKS;

	if (IS_ENABLED(CONFIG_MIPI_DSI)) {
		runp->phy_pwr_gating |= MIPI_TX_DPHY_MASK | MIPI_RX_DPHY_MASK;
		runp->phy_pwr_gating |= MIPI_PLL_DPHY_MASK;
		runp->ip_clock_gating |= CDC200_MASK | MIPI_DSI_MASK | GPU_MASK;
	}
}

void get_default_off_cfg(off_profile_t *offp)
{
	/* Default is STOP mode */
	offp->power_domains = PD_VBAT_AON_MASK; // | PD_SSE700_AON_MASK;
/* If CONFIG_FLASH_BASE_ADDRESS is zero application run from itcm and no MRAM needed */
#if (CONFIG_FLASH_BASE_ADDRESS == 0)
	offp->memory_blocks = 0;
#else
	offp->memory_blocks = MRAM_MASK;
#endif
	offp->memory_blocks |= SERAM_MEMORY_BLOCKS_IN_USE;
	offp->memory_blocks |= APP_RET_MEM_BLOCKS;
	offp->dcdc_voltage = 775;
	offp->ip_clock_gating = 0;
	offp->phy_pwr_gating = 0;
	offp->vdd_ioflex_3V3 = IOFLEX_LEVEL_1V8;
	offp->dcdc_mode = DCDC_MODE_OFF;
	offp->aon_clk_src = CLK_SRC_LFXO;
	offp->stby_clk_src = CLK_SRC_HFRC;
	offp->stby_clk_freq = SCALED_FREQ_RC_STDBY_0_075_MHZ;
	if (counter_source == LPRTC) {
		offp->ewic_cfg = EWIC_RTC_A;
		offp->wakeup_events = WE_LPRTC;
	} else if (counter_source == LPTIMER) {
		offp->ewic_cfg = EWIC_VBAT_TIMER;
		offp->wakeup_events = WE_LPTIMER;
	} else {
		LOG_ERR("Invalid timer source selected");
	}
	offp->vtor_address = SCB->VTOR;
	offp->vtor_address_ns = SCB->VTOR;
}

/**
 * Set the RUN profile parameters for this application.
 */
int app_set_run_params(void)
{
	int ret = se_service_set_run_cfg(&current_runp);

	return ret;
}

/*
 * CRITICAL: Apply the RUN profile at PRE_KERNEL_1 so the SYST clock (and thus
 * the UART baud clock) is set before peripherals initialize. Otherwise the UART
 * divisor is computed against the boot clock and the later switch to the run
 * clock source corrupts the output.
 */
static int app_early_run_cfg(void)
{
	int ret;

	get_default_off_cfg(&current_offp);
	ret = set_off_profile(PM_STATE_MODE_STOP_1);
	if (ret) {
		printk("set_off_profile failed: %d\n", ret);
		return ret;
	}
	get_default_run_cfg(&current_runp);
	ret = app_set_run_params();
	if (ret) {
		printk("get_default_run_cfg failed: %d\n", ret);
		return ret;
	}
	return ret;
}



SYS_INIT(app_early_run_cfg, PRE_KERNEL_1, 3);
```
